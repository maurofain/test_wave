## components/usb_cdc_scanner/Kconfig
```kconfig
menu "USB CDC Scanner"

config USB_CDC_SCANNER_ENABLE
    bool "Enable USB CDC Scanner component"
    default y

config USB_CDC_SCANNER_USE_CDC_ACM_HOST
    bool "Use CDC-ACM Host driver for real device access"
    default n
    depends on USB_OTG_SUPPORTED

config USB_CDC_SCANNER_VID
    hex "Vendor ID (VID) of the scanner"
    default 0x1EAB

config USB_CDC_SCANNER_PID
    hex "Product ID (PID) of the scanner"
    default 0x0006

config USB_CDC_SCANNER_DUAL_PID
    hex "Optional dual PID variant"
    default 0x0000

endmenu
```

## crash/v1.3.0_FACTORY_20260220_192113/config/sdkconfig.defaults
```kconfig
CONFIG_IDF_TARGET="esp32p4"
CONFIG_APP_I2C_PORT=0
CONFIG_APP_I2C_SDA_GPIO=27
CONFIG_APP_I2C_SCL_GPIO=26
CONFIG_APP_I2C_CLOCK_HZ=400000
CONFIG_APP_WS2812_GPIO=5
CONFIG_APP_WS2812_LEDS=8
CONFIG_APP_RS232_UART_PORT=1
CONFIG_APP_RS232_TX_GPIO=0
CONFIG_APP_RS232_RX_GPIO=46
CONFIG_APP_RS485_UART_PORT=2
CONFIG_APP_RS485_TX_GPIO=4
CONFIG_APP_RS485_RX_GPIO=19
CONFIG_APP_RS485_DE_GPIO=21
CONFIG_APP_MDB_UART_PORT=3
CONFIG_APP_MDB_TX_GPIO=22
CONFIG_APP_MDB_RX_GPIO=23
CONFIG_APP_PWM_OUT1_GPIO=47
CONFIG_APP_PWM_OUT2_GPIO=48
CONFIG_APP_WIFI_AP_SSID="factory-setup"
CONFIG_APP_WIFI_AP_PASSWORD="factory123"
CONFIG_APP_WIFI_AP_CHANNEL=6
CONFIG_APP_WIFI_STA_ENABLE=n
CONFIG_APP_WIFI_STA_SSID=""
CONFIG_APP_WIFI_STA_PASSWORD=""
CONFIG_APP_ETH_ENABLED=y
CONFIG_APP_ETH_PHY_ADDR=1
CONFIG_APP_ETH_PHY_RST_GPIO=51
CONFIG_APP_ETH_MDC_GPIO=31
CONFIG_APP_ETH_MDIO_GPIO=52
CONFIG_ESP_SYSTEM_EVENT_TASK_STACK_SIZE=4096
CONFIG_ESP_MAIN_TASK_STACK_SIZE=8192
CONFIG_APP_HTTP_PORT=80
CONFIG_APP_OTA_DEFAULT_URL=""
CONFIG_PARTITION_TABLE_CUSTOM=y
CONFIG_PARTITION_TABLE_CUSTOM_FILENAME="partitions.csv"
CONFIG_PARTITION_TABLE_FILENAME="partitions.csv"
CONFIG_PARTITION_TABLE_OFFSET=0x8000
CONFIG_ESP_HTTPS_OTA_ALLOW_HTTP=y
CONFIG_ESPTOOLPY_FLASHSIZE_16MB=y
CONFIG_ESPTOOLPY_FLASHSIZE="16MB"
CONFIG_ESP_WIFI_STATIC_RX_BUFFER_NUM=16
CONFIG_ESP_WIFI_DYNAMIC_RX_BUFFER_NUM=32
CONFIG_ESP_WIFI_TX_BUFFER_TYPE=0
CONFIG_ESP_WIFI_DYNAMIC_RX_MGMT_BUF=1
CONFIG_ESP_WIFI_ESPNOW_MAX_ENCRYPT_NUM=2
CONFIG_ESP_WIFI_STATIC_TX_BUFFER=y
CONFIG_ESP_WIFI_DYNAMIC_TX_BUFFER=y
CONFIG_ESP_WIFI_STATIC_TX_BUFFER_NUM=16
CONFIG_ESP_WIFI_DYNAMIC_TX_BUFFER_NUM=32
CONFIG_ESP_WIFI_DYNAMIC_RX_MGMT_BUFFER=y
CONFIG_ESP_WIFI_NVS_COMPATIBLE=y

# PSRAM configuration for ESP32-P4 - solo opzioni valide
CONFIG_SPIRAM=y
CONFIG_SPIRAM_SPEED_200M=y

CONFIG_CACHE_L2_CACHE_256KB=y
CONFIG_CACHE_L2_CACHE_LINE_128B=y
#CONFIG_SPIRAM_ALLOW_BSS_SEG_EXTERNAL_MEMORY=y
#CONFIG_SPIRAM_ALLOW_STACK_EXTERNAL_MEMORY=y

# Supporto nomi file lunghi (LFN) per SD Card
CONFIG_FATFS_LFN_HEAP=y
CONFIG_FATFS_MAX_LFN=255

CONFIG_ESP_WIFI_FTM_ENABLE=n
CONFIG_ESP_WIFI_ENABLE=y
CONFIG_ESP_WIFI_ITWT_ENABLE=n
CONFIG_ESP_WIFI_11AX_ENABLE=y

# BSP (Waveshare ESP32-P4-NANO) configuration from lvgl_demo_v9
CONFIG_BSP_ERROR_CHECK=y
CONFIG_BSP_I2C_NUM=1
CONFIG_BSP_I2C_FAST_MODE=y
CONFIG_BSP_I2C_CLK_SPEED_HZ=400000
CONFIG_BSP_I2S_NUM=1
CONFIG_BSP_SD_MOUNT_POINT="/sdcard"
CONFIG_BSP_SPIFFS_MOUNT_POINT="/spiffs"
CONFIG_BSP_SPIFFS_PARTITION_LABEL="storage"
CONFIG_BSP_SPIFFS_MAX_FILES=5
CONFIG_BSP_LCD_DPI_BUFFER_NUMS=0
CONFIG_BSP_DISPLAY_BRIGHTNESS_LEDC_CH=1
CONFIG_BSP_LCD_COLOR_FORMAT_RGB565=y
CONFIG_BSP_LCD_TYPE_720_1280_7_INCH_A=y
CONFIG_BSP_LCD_MIPI_DSI_LANE_BITRATE_MBPS=1500

# LVGL configuration from lvgl_demo_v9
CONFIG_LV_USE_CLIB_MALLOC=y
CONFIG_LV_USE_CLIB_STRING=y
CONFIG_LV_USE_CLIB_SPRINTF=y
CONFIG_LV_DEF_REFR_PERIOD=15
CONFIG_LV_OS_FREERTOS=y
CONFIG_LV_DRAW_SW_DRAW_UNIT_CNT=2
CONFIG_LV_ATTRIBUTE_FAST_MEM_USE_IRAM=y
CONFIG_LV_FONT_MONTSERRAT_12=y
CONFIG_LV_FONT_MONTSERRAT_16=y
CONFIG_LV_USE_SYSMON=n
CONFIG_LV_USE_PERF_MONITOR=n
CONFIG_LV_USE_DEMO_WIDGETS=n
CONFIG_LV_USE_DEMO_BENCHMARK=n
CONFIG_LV_USE_DEMO_RENDER=n
CONFIG_LV_USE_DEMO_SCROLL=n
CONFIG_LV_USE_DEMO_STRESS=n
CONFIG_LV_USE_DEMO_TRANSFORM=n
CONFIG_LV_USE_DEMO_MUSIC=n
CONFIG_LV_DEMO_MUSIC_AUTO_PLAY=n
CONFIG_LV_USE_DEMO_FLEX_LAYOUT=n
CONFIG_LV_USE_DEMO_MULTILANG=n
CONFIG_LV_USE_DEMO_MUSIC=y
CONFIG_LV_DEMO_MUSIC_AUTO_PLAY=y
CONFIG_LV_USE_DEMO_FLEX_LAYOUT=y
CONFIG_LV_USE_DEMO_MULTILANG=y
CONFIG_IDF_EXPERIMENTAL_FEATURES=y

# USB CDC Scanner defaults
CONFIG_USB_CDC_SCANNER_ENABLE=y
CONFIG_USB_OTG_SUPPORTED=y
CONFIG_USB_CDC_SCANNER_USE_CDC_ACM_HOST=y
CONFIG_USB_CDC_SCANNER_VID=0x1EAB
CONFIG_USB_CDC_SCANNER_PID=0x0006
CONFIG_USB_CDC_SCANNER_DUAL_PID=0x0000

# Policy log di boot: minimo rumore all'avvio, con margine di aumento runtime
CONFIG_BOOTLOADER_LOG_LEVEL_ERROR=y
CONFIG_BOOTLOADER_LOG_LEVEL=1
CONFIG_LOG_DEFAULT_LEVEL_ERROR=y
CONFIG_LOG_DEFAULT_LEVEL=1
# non vincolare il massimo al default: possiamo alzare runtime fino a INFO
# CONFIG_LOG_MAXIMUM_EQUALS_DEFAULT is not set
# CONFIG_LOG_MAXIMUM_LEVEL_WARN is not set
CONFIG_LOG_MAXIMUM_LEVEL_INFO=y
# massimo runtime consentito: INFO (es. regolazione dinamica da codice/API)
CONFIG_LOG_MAXIMUM_LEVEL=3

# Core dump persistente in flash (ELF)
CONFIG_ESP_COREDUMP_ENABLE_TO_FLASH=y
CONFIG_ESP_COREDUMP_DATA_FORMAT_ELF=y
```

## main/Kconfig.projbuild
```kconfig
menu "Application configuration"

config APP_I2C_PORT
    int "I2C master port"
    default 0

config APP_I2C_SDA_GPIO
    int "I2C SDA GPIO"
    default 27

config APP_I2C_SCL_GPIO
    int "I2C SCL GPIO"
    default 26

config APP_I2C_CLOCK_HZ
    int "I2C clock (Hz)"
    default 400000

config APP_WS2812_GPIO
    int "WS2812 data GPIO"
    default 5

config APP_WS2812_LEDS
    int "WS2812 LED count"
    default 8

config APP_RS232_UART_PORT
    int "RS232 UART port"
    range 0 3
    default 1

config APP_RS232_TX_GPIO
    int "RS232 TX GPIO"
    default 36

config APP_RS232_RX_GPIO
    int "RS232 RX GPIO"
    default 46

config APP_RS485_UART_PORT
    int "RS485 UART port"
    range 0 3
    default 2

config APP_RS485_TX_GPIO
    int "RS485 TX GPIO"
    default 4

config APP_RS485_RX_GPIO
    int "RS485 RX GPIO"
    default 3

config APP_RS485_DE_GPIO
    int "RS485 DE GPIO"
    default 2

config APP_MDB_UART_PORT
    int "MDB UART port"
    range 0 3
    default 3

config APP_MDB_TX_GPIO
    int "MDB TX GPIO"
    default 22

config APP_MDB_RX_GPIO
    int "MDB RX GPIO"
    default 23

config APP_PWM_OUT1_GPIO
    int "PWM OUT1 GPIO"
    default 47

config APP_PWM_OUT2_GPIO
    int "PWM OUT2 GPIO"
    default 48

config APP_BOOT_BUTTON_GPIO
    int "BOOT button GPIO"
    default 35

config APP_WIFI_AP_SSID
    string "Factory Wi-Fi AP SSID"
    default "factory-setup"

config APP_WIFI_AP_PASSWORD
    string "Factory Wi-Fi AP password (min 8 chars or empty for open)"
    default "factory123"

config APP_WIFI_AP_CHANNEL
    int "Factory Wi-Fi AP channel"
    range 1 13
    default 6

config APP_WIFI_STA_ENABLE
    bool "Enable Wi-Fi station"
    default n

config APP_WIFI_STA_SSID
    string "Wi-Fi station SSID"
    default ""

config APP_WIFI_STA_PASSWORD
    string "Wi-Fi station password"
    default ""

config APP_ETH_ENABLED
    bool "Enable Ethernet (RMII PHY)"
    default n

config APP_ETH_PHY_ADDR
    int "Ethernet PHY address"
    range 0 31
    default 1

config APP_ETH_PHY_RST_GPIO
    int "Ethernet PHY reset GPIO (-1 to disable)"
    default 32 if IDF_TARGET_ESP32P4
    default -1

config APP_ETH_MDC_GPIO
    int "Ethernet MDC GPIO"
    default 31 if IDF_TARGET_ESP32P4
    default 23

config APP_ETH_MDIO_GPIO
    int "Ethernet MDIO GPIO"
    default 52 if IDF_TARGET_ESP32P4
    default 18

config APP_HTTP_PORT
    int "HTTP server port"
    default 80

config APP_OTA_DEFAULT_URL
    string "Default OTA URL (optional)"
    default ""

config APP_DEVICE_STATE_RETRY_DELAY_MS
    int "Retry delay for device state changes (ms)"
    range 200 60000
    default 2000
    help
        Ritardo tra richiesta di cambio stato (scanner/cctalk/mdb) e verifica/ritentativo.

config APP_DEVICE_STATE_MAX_RETRIES
    int "Max retries before OUT_OF_SERVICE"
    range 1 20
    default 5
    help
        Numero massimo di tentativi (falliti) prima di mettere l'impianto in OUT_OF_SERVICE.

endmenu
```

## sdkconfig.defaults
```kconfig
CONFIG_IDF_TARGET="esp32p4"
CONFIG_APP_I2C_PORT=0
CONFIG_APP_I2C_SDA_GPIO=27
CONFIG_APP_I2C_SCL_GPIO=26
CONFIG_APP_I2C_CLOCK_HZ=400000
CONFIG_APP_WS2812_GPIO=5
CONFIG_APP_WS2812_LEDS=8
CONFIG_APP_RS232_UART_PORT=1
CONFIG_APP_RS232_TX_GPIO=36
CONFIG_APP_RS232_RX_GPIO=46
CONFIG_APP_RS485_UART_PORT=2
CONFIG_APP_RS485_TX_GPIO=4
CONFIG_APP_RS485_RX_GPIO=19
CONFIG_APP_RS485_DE_GPIO=21
CONFIG_APP_MDB_UART_PORT=3
CONFIG_APP_MDB_TX_GPIO=22
CONFIG_APP_MDB_RX_GPIO=23
CONFIG_APP_PWM_OUT1_GPIO=47
CONFIG_APP_PWM_OUT2_GPIO=48
CONFIG_APP_WIFI_AP_SSID="factory-setup"
CONFIG_APP_WIFI_AP_PASSWORD="factory123"
CONFIG_APP_WIFI_AP_CHANNEL=6
CONFIG_APP_WIFI_STA_ENABLE=n
CONFIG_APP_WIFI_STA_SSID=""
CONFIG_APP_WIFI_STA_PASSWORD=""
CONFIG_APP_ETH_ENABLED=y
CONFIG_APP_ETH_PHY_ADDR=1
CONFIG_APP_ETH_PHY_RST_GPIO=51
CONFIG_APP_ETH_MDC_GPIO=31
CONFIG_APP_ETH_MDIO_GPIO=52
CONFIG_APP_HTTP_PORT=80
CONFIG_APP_OTA_DEFAULT_URL=""
CONFIG_PARTITION_TABLE_CUSTOM=y
CONFIG_PARTITION_TABLE_CUSTOM_FILENAME="partitions.csv"
CONFIG_PARTITION_TABLE_FILENAME="partitions.csv"
CONFIG_PARTITION_TABLE_OFFSET=0x8000
CONFIG_ESP_HTTPS_OTA_ALLOW_HTTP=y
CONFIG_ESPTOOLPY_FLASHSIZE_16MB=y
CONFIG_ESPTOOLPY_FLASHSIZE="16MB"
CONFIG_ESP_WIFI_STATIC_RX_BUFFER_NUM=16
CONFIG_ESP_WIFI_DYNAMIC_RX_BUFFER_NUM=32
CONFIG_ESP_WIFI_TX_BUFFER_TYPE=0
CONFIG_ESP_WIFI_DYNAMIC_RX_MGMT_BUF=1
CONFIG_ESP_WIFI_ESPNOW_MAX_ENCRYPT_NUM=2
CONFIG_ESP_WIFI_STATIC_TX_BUFFER=y
CONFIG_ESP_WIFI_DYNAMIC_TX_BUFFER=y
CONFIG_ESP_WIFI_STATIC_TX_BUFFER_NUM=16
CONFIG_ESP_WIFI_DYNAMIC_TX_BUFFER_NUM=32
CONFIG_ESP_WIFI_DYNAMIC_RX_MGMT_BUFFER=y
CONFIG_ESP_WIFI_NVS_COMPATIBLE=y
CONFIG_ESP_WIFI_FTM_ENABLE=n
CONFIG_ESP_WIFI_ENABLE=y
CONFIG_ESP_WIFI_ITWT_ENABLE=n
CONFIG_ESP_WIFI_11AX_ENABLE=y
```

## sdkconfig.defaults.SCANNER
```kconfig
# USB CDC Scanner / EPAPER_USB defaults
CONFIG_USB_CDC_SCANNER_ENABLE=y
CONFIG_USB_OTG_SUPPORTED=y
CONFIG_USB_CDC_SCANNER_USE_CDC_ACM_HOST=y
CONFIG_USB_CDC_SCANNER_VID=0x1EAB
CONFIG_USB_CDC_SCANNER_PID=0x0006
CONFIG_USB_CDC_SCANNER_DUAL_PID=0x0000

# Component config → USB-OTG → Hub Driver Configuration
CONFIG_USB_HOST_HUBS_SUPPORTED=y
CONFIG_USB_HOST_HUB_MULTI_LEVEL=y

# DMA / memory
CONFIG_USB_HOST_DWC_DMA_CAP_MEMORY_IN_PSRAM=y
```
